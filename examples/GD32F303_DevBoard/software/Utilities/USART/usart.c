#include "usart.h"
#include "gd32f30x_dma.h"
#include <stdio.h>

#define USART0_RX_DMA_PERIPH       DMA0
#define USART0_RX_DMA_RCU          RCU_DMA0
#define USART0_RX_DMA_CHANNEL      DMA_CH4

/* Private variables */
static uint8_t rx_buffer[USART0_RX_BUFFER_SIZE];
static uint8_t tx_buffer[USART0_TX_BUFFER_SIZE];
static volatile uint16_t tx_head = 0;
static volatile uint16_t tx_tail = 0;
static volatile uint8_t tx_busy = 0;
static volatile uint8_t loopback_enabled = 0;
static usart_rx_callback_t rx_callback = NULL;

/* Private function prototypes */
static uint8_t USART0_BufferIsFull(uint16_t head, uint16_t tail, uint16_t size);
static uint8_t USART0_BufferIsEmpty(uint16_t head, uint16_t tail);
static void USART0_ConfigRxDma(void);
static void USART0_ClearIdleFlag(void);
static void USART0_HandleIdleReceive(void);
static void USART0_EnableInterrupts(void);
static void USART0_DisableInterrupts(void);

/*!
    \brief      Initialize USART0 on PA9/PA10 for communication
    \param[in]  none
    \param[out] none
    \retval     none
*/
void USART0_Init(void)
{
    /* Enable GPIO, USART and receive-DMA clocks. */
    rcu_periph_clock_enable(USART0_GPIO_RCU);
    rcu_periph_clock_enable(USART0_RCU);
    rcu_periph_clock_enable(USART0_RX_DMA_RCU);
    
    /* Configure PA9 as TX and PA10 as RX on the default USART0 mapping. */
    gpio_init(USART0_GPIO, GPIO_MODE_AF_PP, GPIO_OSPEED_50MHZ, USART0_TX_PIN);
    gpio_init(USART0_GPIO, GPIO_MODE_IN_FLOATING, GPIO_OSPEED_50MHZ, USART0_RX_PIN);
    
    /* USART parameter configuration */
    usart_deinit(USART0_PERIPH);
    usart_baudrate_set(USART0_PERIPH, USART0_BAUDRATE);
    usart_word_length_set(USART0_PERIPH, USART0_WORD_LENGTH);
    usart_stop_bit_set(USART0_PERIPH, USART0_STOP_BITS);
    usart_parity_config(USART0_PERIPH, USART0_PARITY);
    usart_hardware_flow_rts_config(USART0_PERIPH, USART0_HARDWARE_FLOW);
    usart_hardware_flow_cts_config(USART0_PERIPH, USART_CTS_DISABLE);

    usart_receive_config(USART0_PERIPH, USART_RECEIVE_ENABLE);
    usart_transmit_config(USART0_PERIPH, USART_TRANSMIT_ENABLE);

    USART0_ConfigRxDma();

    /* Enable USART */
    usart_enable(USART0_PERIPH);

    /* USART0 RX uses DMA0_CH4; no RBNE or DMA channel IRQ is enabled. */
    usart_dma_receive_config(USART0_PERIPH, USART_RECEIVE_DMA_ENABLE);

    /* Clear buffers */
    USART0_ClearBuffers();

    /* Configure NVIC for USART0. */
    NVIC_CONFIG(USART0_IRQN, USART0_PRIORITY_GROUP, USART0_PRIORITY_SUBGROUP);
    
    /* Debug output must not be mixed with automatic receive echo. */
    USART0_LoopbackDisable();
}

/*!
    \brief      Enable loopback mode (echo received data)
    \param[in]  none
    \param[out] none
    \retval     none
*/
void USART0_LoopbackEnable(void)
{
    loopback_enabled = 1;
}

/*!
    \brief      Disable loopback mode
    \param[in]  none
    \param[out] none
    \retval     none
*/
void USART0_LoopbackDisable(void)
{
    loopback_enabled = 0;
}

/*!
    \brief      Send a byte via USART0
    \param[in]  data: byte to send
    \param[out] none
    \retval     status of operation
*/
usart_status_t USART0_SendByte(uint8_t data)
{
    USART0_DisableInterrupts();
    
    /* Check if TX buffer is full */
    if (USART0_BufferIsFull(tx_head, tx_tail, USART0_TX_BUFFER_SIZE)) {
        USART0_EnableInterrupts();
        return USART_STATUS_BUFFER_FULL;
    }
    
    /* Add data to TX buffer */
    tx_buffer[tx_head] = data;
    tx_head = (tx_head + 1) % USART0_TX_BUFFER_SIZE;
    
    /* If transmitter is idle, start transmission */
    if (!tx_busy) {
        tx_busy = 1;
        usart_interrupt_enable(USART0_PERIPH, USART_INT_TBE);
    }
    
    USART0_EnableInterrupts();
    return USART_STATUS_OK;
}

/*!
    \brief      Send a string via USART0
    \param[in]  str: null-terminated string to send
    \param[out] none
    \retval     status of operation
*/
usart_status_t USART0_SendString(const char *str)
{
    usart_status_t status;
    
    while (*str) {
        status = USART0_SendByte(*str++);
        if (status != USART_STATUS_OK) {
            return status;
        }
    }
    
    return USART_STATUS_OK;
}

/*!
    \brief      Retarget the C library standard output to USART0
    \param[in]  ch: character generated by printf
    \param[in]  stream: standard library stream, unused by the UART driver
    \retval     transmitted character on success, EOF on failure
    \note       Call printf only from thread/main-loop context.
*/
int fputc(int ch, FILE *stream)
{
    usart_status_t status;

    (void)stream;
    do {
        status = USART0_SendByte((uint8_t)ch);
    } while (status == USART_STATUS_BUFFER_FULL);

    if (status != USART_STATUS_OK) {
        return EOF;
    }
    return ch;
}

/*!
    \brief      Clear USART0 buffers and restart the receive DMA channel
    \param[in]  none
    \param[out] none
    \retval     none
*/
void USART0_ClearBuffers(void)
{
    USART0_DisableInterrupts();

    dma_channel_disable(USART0_RX_DMA_PERIPH, USART0_RX_DMA_CHANNEL);
    dma_flag_clear(USART0_RX_DMA_PERIPH,
                   USART0_RX_DMA_CHANNEL,
                   DMA_FLAG_G);
    dma_memory_address_config(USART0_RX_DMA_PERIPH,
                              USART0_RX_DMA_CHANNEL,
                              (uint32_t)rx_buffer);
    dma_transfer_number_config(USART0_RX_DMA_PERIPH,
                               USART0_RX_DMA_CHANNEL,
                               USART0_RX_BUFFER_SIZE);

    tx_head = 0;
    tx_tail = 0;
    tx_busy = 0;

    memset(rx_buffer, 0, sizeof(rx_buffer));
    memset(tx_buffer, 0, sizeof(tx_buffer));

    USART0_ClearIdleFlag();
    dma_channel_enable(USART0_RX_DMA_PERIPH, USART0_RX_DMA_CHANNEL);

    USART0_EnableInterrupts();
}

/*!
    \brief      Set DMA + IDLE receive callback function
    \param[in]  callback: function called with one completed receive batch
    \param[out] none
    \retval     none
    \note       The callback runs in USART0 interrupt context and must not block
*/
void USART0_SetRxCallback(usart_rx_callback_t callback)
{
    rx_callback = callback;
}

/*!
    \brief      USART0 interrupt handler implementation
    \param[in]  none
    \param[out] none
    \retval     none
*/
static void USART0_HandlerInternal(void)
{
    /* RX DMA batch is complete after one USART frame of line idle time. */
    if (usart_interrupt_flag_get(USART0_PERIPH,
                                 USART_INT_FLAG_IDLE) != RESET) {
        USART0_HandleIdleReceive();
    }
    
    /* Transmit buffer empty interrupt */
    if (usart_interrupt_flag_get(USART0_PERIPH, USART_INT_FLAG_TBE) != RESET) {
        if (!USART0_BufferIsEmpty(tx_head, tx_tail)) {
            /* Send next byte */
            usart_data_transmit(USART0_PERIPH, tx_buffer[tx_tail]);
            tx_tail = (tx_tail + 1) % USART0_TX_BUFFER_SIZE;
        } else {
            /* No more data to send, disable TBE interrupt */
            usart_interrupt_disable(USART0_PERIPH, USART_INT_TBE);
            tx_busy = 0;
        }
        
        usart_interrupt_flag_clear(USART0_PERIPH, USART_INT_FLAG_TBE);
    }
}

/*!
    \brief      Configure DMA0_CH4 for one USART0 receive batch
    \param[in]  none
    \param[out] none
    \retval     none
    \note       DMA interrupts and circulation mode remain disabled
*/
static void USART0_ConfigRxDma(void)
{
    dma_parameter_struct dma_init_struct;

    dma_deinit(USART0_RX_DMA_PERIPH, USART0_RX_DMA_CHANNEL);
    dma_struct_para_init(&dma_init_struct);
    dma_init_struct.periph_addr = (uint32_t)&USART_DATA(USART0_PERIPH);
    dma_init_struct.periph_inc = DMA_PERIPH_INCREASE_DISABLE;
    dma_init_struct.memory_addr = (uint32_t)rx_buffer;
    dma_init_struct.memory_inc = DMA_MEMORY_INCREASE_ENABLE;
    dma_init_struct.periph_width = DMA_PERIPHERAL_WIDTH_8BIT;
    dma_init_struct.memory_width = DMA_MEMORY_WIDTH_8BIT;
    dma_init_struct.direction = DMA_PERIPHERAL_TO_MEMORY;
    dma_init_struct.number = USART0_RX_BUFFER_SIZE;
    dma_init_struct.priority = DMA_PRIORITY_LOW;
    dma_init(USART0_RX_DMA_PERIPH,
             USART0_RX_DMA_CHANNEL,
             &dma_init_struct);
    dma_circulation_disable(USART0_RX_DMA_PERIPH, USART0_RX_DMA_CHANNEL);
    dma_interrupt_disable(USART0_RX_DMA_PERIPH,
                          USART0_RX_DMA_CHANNEL,
                          DMA_INT_FTF | DMA_INT_HTF | DMA_INT_ERR);
}

/*!
    \brief      Clear USART0 IDLE by the required STAT0 then DATA read sequence
    \param[in]  none
    \param[out] none
    \retval     none
*/
static void USART0_ClearIdleFlag(void)
{
    volatile uint32_t idle_clear;

    idle_clear = USART_STAT0(USART0_PERIPH);
    idle_clear = USART_DATA(USART0_PERIPH);
    (void)idle_clear;
}

/*!
    \brief      Complete one RX DMA batch and dispatch it from IDLE ISR context
    \param[in]  none
    \param[out] none
    \retval     none
*/
static void USART0_HandleIdleReceive(void)
{
    uint32_t remaining_count;
    uint16_t received_length;
    uint16_t index;

    USART0_ClearIdleFlag();
    dma_channel_disable(USART0_RX_DMA_PERIPH, USART0_RX_DMA_CHANNEL);
    remaining_count = dma_transfer_number_get(USART0_RX_DMA_PERIPH,
                                               USART0_RX_DMA_CHANNEL);
    if (remaining_count <= USART0_RX_BUFFER_SIZE) {
        received_length = (uint16_t)(USART0_RX_BUFFER_SIZE -
                                     remaining_count);
    } else {
        received_length = 0U;
    }

    if ((received_length != 0U) && (rx_callback != NULL)) {
        rx_callback(rx_buffer, received_length);
    }

    if (loopback_enabled != 0U) {
        for (index = 0U; index < received_length; index++) {
            (void)USART0_SendByte(rx_buffer[index]);
        }
    }

    dma_flag_clear(USART0_RX_DMA_PERIPH,
                   USART0_RX_DMA_CHANNEL,
                   DMA_FLAG_G);
    dma_memory_address_config(USART0_RX_DMA_PERIPH,
                              USART0_RX_DMA_CHANNEL,
                              (uint32_t)rx_buffer);
    dma_transfer_number_config(USART0_RX_DMA_PERIPH,
                               USART0_RX_DMA_CHANNEL,
                               USART0_RX_BUFFER_SIZE);
    dma_channel_enable(USART0_RX_DMA_PERIPH, USART0_RX_DMA_CHANNEL);
}

/*!
    \brief      USART0 interrupt handler (to be called from gd32f30x_it.c)
    \param[in]  none
    \param[out] none
    \retval     none
*/
void USART0_IRQHandler_Internal(void)
{
    USART0_HandlerInternal();
}

/*!
    \brief      Check if buffer is full
    \param[in]  head: buffer head index
    \param[in]  tail: buffer tail index
    \param[in]  size: buffer size
    \param[out] none
    \retval     1 if full, 0 otherwise
*/
static uint8_t USART0_BufferIsFull(uint16_t head, uint16_t tail, uint16_t size)
{
    return ((head + 1) % size) == tail;
}

/*!
    \brief      Check if buffer is empty
    \param[in]  head: buffer head index
    \param[in]  tail: buffer tail index
    \param[out] none
    \retval     1 if empty, 0 otherwise
*/
static uint8_t USART0_BufferIsEmpty(uint16_t head, uint16_t tail)
{
    return head == tail;
}

/*!
    \brief      Disable USART0 interrupts (for critical sections)
    \param[in]  none
    \param[out] none
    \retval     none
*/
static void USART0_DisableInterrupts(void)
{
    usart_interrupt_disable(USART0_PERIPH, USART_INT_IDLE);
    usart_interrupt_disable(USART0_PERIPH, USART_INT_TBE);
}

/*!
    \brief      Enable USART0 interrupts
    \param[in]  none
    \param[out] none
    \retval     none
*/
static void USART0_EnableInterrupts(void)
{
    usart_interrupt_enable(USART0_PERIPH, USART_INT_IDLE);
    if (tx_busy) {
        usart_interrupt_enable(USART0_PERIPH, USART_INT_TBE);
    }
}
